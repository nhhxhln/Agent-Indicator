## Demo/main/Kconfig.projbuild
```kconfig
menu "Agent Indicator (Demo)"

    config AGENTIND_WIFI_SSID
        string "Wi-Fi SSID (PC AP)"
        default "agentind-ap"

    config AGENTIND_WIFI_PASSWORD
        string "Wi-Fi password"
        default "agentind123"

    config AGENTIND_MATRIX_TILES
        int "Matrix tiles (1 = 8x8, 4 = 16x16)"
        range 1 4
        default 1

    config AGENTIND_VLED_BUDGET_MA
        int "VLED current budget (mA)"
        default 4500

    config AGENTIND_ENABLE_SD
        bool "Enable on-board microSD"
        default y
        help
            Demo:SD 用独立引脚(CLK4/CMD5/DAT6),默认启用;未插卡只报错不 panic。

    config AGENTIND_ENABLE_CAN
        bool "Enable CAN/TWAI"
        default y
        help
            Demo:TWAI TX47/RX21,默认启用。

endmenu
```

## Demo/sdkconfig.defaults
```kconfig
# Demo 最小可移植默认配置(进 git)。换机器/全新 checkout:
#   rm -rf build sdkconfig && idf.py set-target esp32s3 build
# 只列「非默认且必需」项;其余沿用 IDF/Kconfig 默认(SD/CAN/MATRIX_TILES、CPU 160MHz 等本就是默认)。

CONFIG_IDF_TARGET="esp32s3"

# 16MB flash(partitions.csv 的 storage 到 ~14.7MB;默认 2MB 装不下)
CONFIG_ESPTOOLPY_FLASHSIZE_16MB=y

# 8MB 八线 PSRAM(N16R8;LVGL/大缓冲依赖,默认不启用)
CONFIG_SPIRAM=y
CONFIG_SPIRAM_MODE_OCT=y
CONFIG_SPIRAM_SPEED_80M=y

# 自定义分区表(FILENAME 默认即 partitions.csv)
CONFIG_PARTITION_TABLE_CUSTOM=y

# 控制台/日志走 USB-Serial-JTAG(GPIO19/20),默认是 UART0
CONFIG_ESP_CONSOLE_USB_SERIAL_JTAG=y

# HTTP Server WebSocket:comm_wifi.c 的 /ws 编译必需(默认关)
CONFIG_HTTPD_WS_SUPPORT=y

# LVGL 必须用 CLIB malloc(内置 TLSF 池会 OOM 死循环);UI 用到 14/16/20 号字
CONFIG_LV_USE_CLIB_MALLOC=y
CONFIG_LV_FONT_MONTSERRAT_16=y
CONFIG_LV_FONT_MONTSERRAT_20=y

# 重新启用 Wi-Fi 时再加这条(否则 station static buffer OOM):
# CONFIG_SPIRAM_TRY_ALLOCATE_WIFI_LWIP=y
```

## RgbBridge/sdkconfig.defaults
```kconfig
# RgbBridge 最小可移植默认配置。换机:rm -rf build sdkconfig && idf.py set-target esp32s3 build
CONFIG_IDF_TARGET="esp32s3"

# Flash(单 app 足够;桥片代码很小)
CONFIG_ESPTOOLPY_FLASHSIZE_8MB=y

# 八线 PSRAM:RGB 帧缓冲(480×480×2≈460KB)+ 双缓冲必须放 PSRAM
CONFIG_SPIRAM=y
CONFIG_SPIRAM_MODE_OCT=y
CONFIG_SPIRAM_SPEED_80M=y
# RGB panel 的帧缓冲走 PSRAM,需要更高带宽:允许 80M + XIP
CONFIG_SPIRAM_FETCH_INSTRUCTIONS=y
CONFIG_SPIRAM_RODATA=y

# 控制台/日志走 USB-Serial-JTAG(19/20)
CONFIG_ESP_CONSOLE_USB_SERIAL_JTAG=y

# LCD RGB 需要较大主频
CONFIG_ESP_DEFAULT_CPU_FREQ_MHZ_240=y
```

## RgbBridgeHost/sdkconfig.defaults
```kconfig
# RgbBridgeHost 最小默认配置。rm -rf build sdkconfig && idf.py set-target esp32s3 build
CONFIG_IDF_TARGET="esp32s3"
CONFIG_ESPTOOLPY_FLASHSIZE_8MB=y
CONFIG_ESP_CONSOLE_USB_SERIAL_JTAG=y
```

## firmware/main/Kconfig.projbuild
```kconfig
menu "Agent Indicator"

    config AGENTIND_WIFI_SSID
        string "Wi-Fi SSID (PC AP)"
        default "agentind-ap"

    config AGENTIND_WIFI_PASSWORD
        string "Wi-Fi password"
        default "agentind123"

    config AGENTIND_MATRIX_TILES
        int "Matrix tiles (1 = 8x8, 4 = 16x16)"
        range 1 4
        default 1

    config AGENTIND_VLED_BUDGET_MA
        int "VLED current budget (mA)"
        default 4500

    config AGENTIND_ENABLE_SD
        bool "Enable on-board microSD (DevKitC-1: D0 conflicts with I2S DOUT)"
        default n
        help
            DevKitC-1 GPIO 不足以同时跑 RGB 屏+音频+SD。启用前请在转接板上
            为 SD 改接独立引脚,或禁用音频。

    config AGENTIND_ENABLE_CAN
        bool "Enable CAN/TWAI (DevKitC-1: conflicts with backlight PWM / I2S)"
        default n
        help
            TWAI 经 GPIO matrix 可路由任意空脚;启用前确认引脚不与背光/I2S 冲突。

endmenu
```

## firmware/sdkconfig.defaults
```kconfig
# ESP32-S3-WROOM-1-N16R8
CONFIG_IDF_TARGET="esp32s3"

# Flash 16MB / Octal PSRAM 8MB
CONFIG_ESPTOOLPY_FLASHSIZE_16MB=y
CONFIG_ESPTOOLPY_FLASHMODE_QIO=y
CONFIG_SPIRAM=y
CONFIG_SPIRAM_MODE_OCT=y
CONFIG_SPIRAM_SPEED_80M=y
CONFIG_SPIRAM_FETCH_INSTRUCTIONS=y
CONFIG_SPIRAM_RODATA=y

# 分区表
CONFIG_PARTITION_TABLE_CUSTOM=y
CONFIG_PARTITION_TABLE_CUSTOM_FILENAME="partitions.csv"

# RGB LCD 帧缓冲在 PSRAM,提升带宽稳定性
CONFIG_LCD_RGB_ISR_IRAM_SAFE=y
CONFIG_LCD_RGB_RESTART_IN_VSYNC=y

# WebSocket server(comm_wifi)
CONFIG_HTTPD_WS_SUPPORT=y

# FreeRTOS 1kHz tick,动画引擎用
CONFIG_FREERTOS_HZ=1000

# log/REPL 走 UART0 串口(GPIO43 TX / 44 RX),不占用 USB —— USB 留给
# TinyUSB CDC/vendor EP。注意 UART0 与 TWAI 复用 43/44:跑 CAN 时在
# menuconfig 把控制台切回 USB Serial/JTAG(CONFIG_ESP_CONSOLE_USB_SERIAL_JTAG)
CONFIG_ESP_CONSOLE_UART_DEFAULT=y
CONFIG_ESP_CONSOLE_UART_BAUDRATE=115200

# LVGL 用 esp 堆(默认内置 TLSF 池仅 64KB,六页 UI 会 OOM 死循环)
CONFIG_LV_USE_CLIB_MALLOC=y

# LVGL:POSIX 文件系统(盘符 A: 映射 VFS 根,可访问 /spiffs 与 /sdcard)+ TinyTTF
CONFIG_LV_USE_FS_POSIX=y
CONFIG_LV_FS_POSIX_LETTER=65
CONFIG_LV_FS_POSIX_PATH=""
CONFIG_LV_USE_TINY_TTF=y
CONFIG_LV_TINY_TTF_FILE_SUPPORT=y
CONFIG_LV_FONT_MONTSERRAT_14=y
CONFIG_LV_FONT_MONTSERRAT_16=y
CONFIG_LV_FONT_MONTSERRAT_20=y
CONFIG_LV_FONT_MONTSERRAT_24=y
CONFIG_LV_FONT_MONTSERRAT_32=y
```
